## main/Kconfig.projbuild
```kconfig
menu "Application Configuration"

    config RUN_UNIT_TESTS
        bool "Enable Unity Test Menu"
        default n
        help
            Enable the Unity test menu in main.c instead of running the normal application.
            When enabled, the device will boot into an interactive test menu where you can
            run unit tests from all components.

            This is useful for development and testing. Disable for production builds.

endmenu
```

## sdkconfig.defaults
```kconfig
# SDK defaults for v5.5.1
# Flash and partition configuration (8MB)
CONFIG_ESPTOOLPY_FLASHSIZE_8MB=y
CONFIG_PARTITION_TABLE_CUSTOM=y
CONFIG_PARTITION_TABLE_CUSTOM_FILENAME="partitions.csv"

# Wi-Fi and BLE coexistence
CONFIG_BT_ENABLED=y
CONFIG_ESP_WIFI_ENABLED=y
CONFIG_BT_NIMBLE_ENABLED=y

# HTTP server
CONFIG_HTTPD_MAX_REQ_HDR_LEN=2048
CONFIG_HTTPD_MAX_URI_LEN=256

# OTA
CONFIG_ESP_HTTPS_OTA=y

# SNTP
CONFIG_LWIP_SNTP_MAX_SERVERS=3

# LWIP socket options
CONFIG_LWIP_SO_REUSE=y
CONFIG_LWIP_SO_RCVTIMEO=y
CONFIG_LWIP_TCP_KEEPALIVE=y
CONFIG_TCP_KEEPALIVE_IDLE=60
CONFIG_TCP_KEEPALIVE_INTERVAL=10
CONFIG_TCP_KEEPALIVE_COUNT=3

# mbedTLS for TLS/HTTPS support
CONFIG_MBEDTLS_CERTIFICATE_BUNDLE=y
CONFIG_MBEDTLS_CERTIFICATE_BUNDLE_DEFAULT_FULL=y

# Logging
CONFIG_LOG_DEFAULT_LEVEL_INFO=y
CONFIG_LOG_BUFFER_SIZE=512

# Task Watchdog Timer
CONFIG_ESP_TASK_WDT_EN=y
CONFIG_ESP_TASK_WDT_TIMEOUT_S=10
CONFIG_ESP_TASK_WDT_INIT=n

# Provisioning Security 1 with PoP
CONFIG_WIFI_PROV_SECURITY_VERSION_1=y

# UART for GNSS (high-performance ISR in IRAM)
CONFIG_UART_ISR_IN_IRAM=y
```
